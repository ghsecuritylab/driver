## board/Kconfig
```kconfig
menu "Hardware Drivers Config"

config SOC_STM32H743VI
    bool
    select SOC_SERIES_STM32H7
    select RT_USING_COMPONENTS_INIT
    select RT_USING_USER_MAIN
    default y

menu "Onboard Peripheral Drivers"
    config BSP_USING_Board_AD
        bool "Enable AD7739"
        default n
	
    config BSP_USING_Board_FM
        bool "Enable FM25CL64"
        default n

    config BSP_USING_Board_LCD
        bool "Enable LCD 2.44"
        default n

    config BSP_USING_Board_FLASH
        bool "Enable W25Q256 FLASH"
        default n

endmenu

menu "On-chip Peripheral Drivers"

    config BSP_USING_GPIO
        bool "Enable GPIO"
        select RT_USING_PIN
        default y

    menuconfig BSP_USING_UART
        bool "Enable UART"
        default y
        select RT_USING_SERIAL
        if BSP_USING_UART
            config BSP_USING_UART1
                bool "Enable UART1"
                default y
            config BSP_USING_UART3
                bool "Enable UART3"
                default n
        endif

    menuconfig BSP_USING_SPI
        bool "Enable SPI"
        default n
        select RT_USING_SPI
        if BSP_USING_SPI
            config BSP_USING_SPI1
                bool "Enable SPI1"
                default n
            config BSP_USING_SPI4
                bool "Enable SPI4"
                default n
        endif

    config BSP_USING_FMC
        bool
        default n

    config BSP_USING_LTDC
        bool
        default n

    config BSP_USING_QSPI
        bool "Enable QSPI BUS"
        select RT_USING_QSPI
        select RT_USING_SPI
        default n

    menuconfig BSP_USING_ONCHIP_RTC
        bool "Enable RTC"
        select RT_USING_RTC
        select RT_USING_LIBC
        default n
        if BSP_USING_ONCHIP_RTC
            choice
                prompt "Select clock source"
                default BSP_RTC_USING_LSE

                config BSP_RTC_USING_LSE
                    bool "RTC USING LSE"

                config BSP_RTC_USING_LSI
                    bool "RTC USING LSI"
            endchoice
        endif

    config BSP_USING_WDT
        bool "Enable Watchdog Timer"
        select RT_USING_WDT
        default n

	
    source "libraries/HAL_Drivers/Kconfig"

endmenu

menu "Board extended module Drivers"
	config Board_Using_Rocker
	bool "Enable Rocker Device"
	default n
	
	config Board_Using_Button
	bool "Enable Button Device"
	default n
endmenu
 
endmenu
```
